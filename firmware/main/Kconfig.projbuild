## firmware/main/Kconfig.projbuild
```kconfig
menu "Board Configuration"

choice BOARD_TYPE_CHOICE
    prompt "Board Type"
    help
        Select the board type for this project.
    default BOARD_TYPE_BOSE_OPEN_EARBUD_ULTRA

    # 对应文件夹名：bose-open-earbud-ultra
    config BOARD_TYPE_BOSE_OPEN_EARBUD_ULTRA
        bool "bose-open-earbud-ultra"
        help
            Bose Open Earbud Ultra TWS board with ESP32S3.

    # 对应截图中的设备名：LE-Bose QC Earbuds → 文件夹/显示名：le-bose-qc-earbuds
    config BOARD_TYPE_LE_BOSE_QC_EARBUDS
        bool "le-bose-qc-earbuds"
        help
            LE-Bose QC Earbuds TWS board configuration.

endchoice

endmenu
```

## firmware/sdkconfig.defaults
```kconfig
# Espressif IoT Development Framework (ESP-IDF) Project Configuration
#
CONFIG_IDF_TARGET="esp32s3"
CONFIG_PARTITION_TABLE_CUSTOM=y
CONFIG_PARTITION_TABLE_CUSTOM_FILENAME="partitions/v1/16m.csv"

CONFIG_BT_ENABLED=y
CONFIG_BT_CLASSIC_ENABLED=y
CONFIG_BT_BLE_ENABLED=y
```

## firmware/sdkconfig.defaults.esp32
```kconfig
CONFIG_ESPTOOLPY_FLASHSIZE_8MB=y
CONFIG_PARTITION_TABLE_CUSTOM=y
CONFIG_PARTITION_TABLE_CUSTOM_FILENAME="partitions/v1/8m.csv"
CONFIG_ESP_TASK_WDT_TIMEOUT_S=20

CONFIG_BT_SPP_ENABLED=y
CONFIG_BTDM_CTRL_MODE_BTDM=y
```

## firmware/sdkconfig.defaults.esp32s3
```kconfig
CONFIG_ESPTOOLPY_FLASHSIZE_16MB=y
CONFIG_PARTITION_TABLE_CUSTOM=y
CONFIG_PARTITION_TABLE_CUSTOM_FILENAME="partitions/v1/16m.csv"
CONFIG_ESP_TASK_WDT_TIMEOUT_S=20
```
